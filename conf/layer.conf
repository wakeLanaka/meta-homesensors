## conf/layer.conf
```bitbake
# We have a conf and classes directory, add to BBPATH
BBPATH .= ":${LAYERDIR}"

# We have recipes-* directories, add to BBFILES
BBFILES += "${LAYERDIR}/recipes-*/*/*.bb \
            ${LAYERDIR}/recipes-*/*/*.bbappend"

BBFILE_COLLECTIONS += "meta-homesensors"
BBFILE_PATTERN_meta-homesensors = "^${LAYERDIR}/"
BBFILE_PRIORITY_meta-homesensors = "6"

LAYERDEPENDS_meta-homesensors = "core"
LAYERSERIES_COMPAT_meta-homesensors = "kirkstone"
```
